## init/Kconfig.rej
```kconfig
--- init/Kconfig
+++ init/Kconfig
@@ -1759,6 +1759,7 @@ choice
 
 config SLAB
 	bool "SLAB"
+	depends on !PREEMPT_RT_FULL
 	select HAVE_HARDENED_USERCOPY_ALLOCATOR
 	help
 	  The regular slab allocator that is established and known to work
```
